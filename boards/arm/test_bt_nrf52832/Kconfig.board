## boards/arm/test_bt_nrf52832/Kconfig.board
```kconfig
# TEST BT nRF52832 board configuration

# Copyright (c) 2018 Nordic Semiconductor ASA
# SPDX-License-Identifier: Apache-2.0

config TEST_BT_NRF52832
	bool "nRF52 FILO BT NRF52832"
	depends on SOC_NRF52832_QFAA
```

## src/modules/vl53lx/Kconfig
```kconfig
# VL53LX time of flight sensor configuration options

# Copyright (c) 2017 STMicroelectronics
# SPDX-License-Identifier: Apache-2.0

config VL53LX
 	bool "VL53LX time of flight sensor"
 	depends on I2C

if VL53LX
module = VL53LX
module-str = VL53LX
#source "subsys/logging/Kconfig.template.log_config"
endif
```
